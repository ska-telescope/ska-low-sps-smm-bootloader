## board/sanitas/inventami/Kconfig
```kconfig
if TARGET_INVENTAMI

config SYS_BOARD
	default "inventami"

config SYS_VENDOR
	default "sanitas"

config SYS_SOC
	default "mx6"

config SYS_CONFIG_NAME
	default "inventami"

endif
```

## board/sanitas/ska_management/Kconfig
```kconfig
if TARGET_SKA_MANAGEMENT

config SYS_BOARD
	default "ska_management"

config SYS_VENDOR
	default "sanitas"

config SYS_CONFIG_NAME
	default "ska_management"

config SYS_TEXT_BASE
    default 0x17800000

endif
```

## configs/inventami_defconfig
```kconfig
CONFIG_ARM=y
CONFIG_ARCH_MX6=y
CONFIG_TARGET_INVENTAMI=y
CONFIG_SYS_EXTRA_OPTIONS="IMX_CONFIG=board/sanitas/inventami/inventami.cfg,MX6Q"
```

## configs/ska_management_defconfig
```kconfig
CONFIG_ARM=y
CONFIG_ARCH_MX6=y
CONFIG_TARGET_SKA_MANAGEMENT=y
CONFIG_SYS_EXTRA_OPTIONS="IMX_CONFIG=board/sanitas/ska_management/ska_management.cfg,MX6Q"
```
